/dts-v1/;
/plugin/;

/ {
    compatible = "brcm,bcm2835";

    /* 第 1 步：精準瞄準並關閉預設的 spidev0 */
    fragment@0 {
        target = <&spidev0>;
        __overlay__ {
            status = "disabled";
        };
    };

    /* 第 2 步：在 spi0 控制器上，掛載你的驅動 */
    fragment@1 {
        target = <&spi0>;
        __overlay__ {
            #address-cells = <1>;
            #size-cells = <0>;
            status = "okay";

            pov_apa102@0 {
                compatible = "custom,pov_apa102";
                reg = <0>;                       /* 解決 reg 警告：對應 @0 */
                spi-max-frequency = <15000000>;  /* 15 MHz */
            };
        };
    };
};